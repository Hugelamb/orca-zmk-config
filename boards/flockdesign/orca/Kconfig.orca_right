## boards/flockdesign/orca/Kconfig.orca_right
```kconfig
# Orca board configuration

# Copyright (c) 2024 Hugh Lam
# SPDX-License-Identifier: MIT

config BOARD_ORCA_RIGHT
  select SOC_NRF52840_QIAA
  select ZMK_BOARD_COMPAT
    
```

## boards/flockdesign/orca/board.yml
```yaml
boards:
  - name: orca_left
    vendor: flockdesign
    socs:
      - name: nrf52840
        variants:
          - name: zmk 
    revision:
      format: major.minor.patch
      default: 1.0.0
      exact: false
      revisions:
        - name: 1.0.0
  - name: orca_right
    vendor: flockdesign
    socs:
      - name: nrf52840
        variants:
          - name: zmk 
    revision:
      format: major.minor.patch
      default: 1.0.0
      exact: false
      revisions:
        - name: 1.0.0
```
