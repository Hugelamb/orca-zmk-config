/* 
 *  Created by Hugh Lam (2024)
 *
 *  orca .dts file.
 */

// /dts-v1/;
// #include <nordic/nrf52840_qiaa.dtsi>
// #include <dt-bindings/zmk/matrix_transform.h>
// #include <dt-bindings/led/led.h>
#include "orca_base.dts"
// Troubleshooting gpio pins


/ {

    kscan: kscan {
		compatible = "zmk,kscan-gpio-direct";
        wakeup-source;

        input-gpios
            = <&gpio1  6 (GPIO_ACTIVE_LOW | GPIO_PULL_UP)>  // 1
            , <&gpio1  4 (GPIO_ACTIVE_LOW | GPIO_PULL_UP)>  // 2
            , <&gpio1  1 (GPIO_ACTIVE_LOW | GPIO_PULL_UP)>  // 3
            , <&gpio1  0 (GPIO_ACTIVE_LOW | GPIO_PULL_UP)>  // ...
            , <&gpio0 30 (GPIO_ACTIVE_LOW | GPIO_PULL_UP)>

            , <&gpio1 11 (GPIO_ACTIVE_LOW | GPIO_PULL_UP)>
            , <&gpio1  2 (GPIO_ACTIVE_LOW | GPIO_PULL_UP)>
            , <&gpio1 15 (GPIO_ACTIVE_LOW | GPIO_PULL_UP)>
            , <&gpio0 28 (GPIO_ACTIVE_LOW | GPIO_PULL_UP)>
            , <&gpio0  5 (GPIO_ACTIVE_LOW | GPIO_PULL_UP)>

            , <&gpio1 10 (GPIO_ACTIVE_LOW | GPIO_PULL_UP)>
            , <&gpio1 13 (GPIO_ACTIVE_LOW | GPIO_PULL_UP)>
            , <&gpio1  3 (GPIO_ACTIVE_LOW | GPIO_PULL_UP)>
            , <&gpio0 29 (GPIO_ACTIVE_LOW | GPIO_PULL_UP)>
            , <&gpio0 22 (GPIO_ACTIVE_LOW | GPIO_PULL_UP)>

            , <&gpio0  9 (GPIO_ACTIVE_LOW | GPIO_PULL_UP)>  // 16
            , <&gpio0 10 (GPIO_ACTIVE_LOW | GPIO_PULL_UP)>  // 17
            ;
	};
};

&transform {
    col-offset = <17>;
};

