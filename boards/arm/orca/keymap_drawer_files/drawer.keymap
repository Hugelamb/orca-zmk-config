/* 
 *  Created by Hugh Lam (2024)
 *
 *  orca keymap
 */

#include <behaviors.dtsi>
#include <dt-bindings/zmk/keys.h>
#include <dt-bindings/zmk/bt.h>
#include <dt-bindings/zmk/ext_power.h>
#include <dt-bindings/zmk/rgb.h>
#include <dt-bindings/zmk/outputs.h>

// non-standard modules
#include "zmk-includes/helper.h"
#include "zmk-includes/34.h"
#include <behaviors/num_word.dtsi>  // add num_word behaviour by urob, from https://github.com/urob/zmk-auto-layer.git repository
#include "orca-layouts.dtsi"     // uncomment once the config supports ZMK Studio 
// Unicode combos
#include "zmk-includes/greek.dtsi"
#include "zmk-includes/math.dtsi"

// use helper macros to define left and right hand positions
#define KEYS_L LT0 LT1 LT2 LT3 LT4 LM0 LM1 LM2 LM3 LM4 LB0 LB1 LB2 LB3 LB4  // left-hand keys
#define KEYS_R RT0 RT1 RT2 RT3 RT4 RM0 RM1 RM2 RM3 RM4 RB0 RB1 RB2 RB3 RB4  // right-hand keys
#define THUMBS LH1 LH0 RH0 RH1 

#define XXX &none
#define ___ &trans

/* Global Settings */
#define QUICK_TAP_MS 175

// urob's Timeless HRM's
#define MAKE_HRM(NAME, HOLD, TAP, TRIGGER_POS) \
    ZMK_HOLD_TAP(NAME, \
        flavor = "balanced"; \
        tapping-term-ms = <280>; \
        quick-tap-ms = <QUICK_TAP_MS>; \
        require-prior-idle-ms = <150>; \
        bindings = <HOLD>, <TAP>; \
        hold-trigger-key-positions = <TRIGGER_POS>; \
        hold-trigger-on-release; \
    )
MAKE_HRM(hml, &kp, &kp, KEYS_R THUMBS)  // left-hand HRMs
MAKE_HRM(hmr, &kp, &kp, KEYS_L THUMBS)  // right-hand HRMs

// HRM with changed timeouts for gui only
// tapping-term-ms : 280 >> 350
// quick-tap-ms : 175 >> 200
// require-prior-idle-ms : 150 >> 150
#define MAKE_HR_GUI(NAME, HOLD, TAP, TRIGGER_POS) \
    ZMK_HOLD_TAP(NAME, \
        flavor = "balanced"; \
        tapping-term-ms = <350>; \
        quick-tap-ms = <200>; \
        require-prior-idle-ms = <150>; \
        bindings = <HOLD>, <TAP>; \
        hold-trigger-key-positions = <TRIGGER_POS>; \
        hold-trigger-on-release; \
    )

MAKE_HR_GUI(hgl, &kp, &kp,KEYS_R THUMBS) // left-hand GUI
MAKE_HR_GUI(hgr, &kp, &kp,KEYS_L THUMBS) // right-hand GUI

// Layer defines
#define DEF 0
#define COL_DH 1
#define SYM 2       // Commonly used symbols
#define NUM 3
#define NAV 4       // arrow keys, PGUP/PGDN, back, forward, window swappers, 
#define FUN 5       // F keys, print screen, insert, etc.
#define SYS 6       // Board related functions, BT profiles, reset, bootloader, ext power cutoff.
#define HLW 7
#define StS 8
// #define MOU 6
// Conditional layer change
ZMK_CONDITIONAL_LAYER(fun, NAV SYM, FUN)  // NAV + SYM => FUN

// NAV Layer macros
#define NAV_BSPC    &mt LC(BSPC) BSPC   // tap: backspace | long-tap: delete word backwards
#define NAV_DEL     &mt LC(DEL) DEL     // tap: delete | long-tap: delete word forwards

// Desktop window management and tab nav shortcuts
#define D_LT        &kp LG(LC(LEFT))     // move desktop left
#define D_RT        &kp LG(LC(RIGHT))    // move desktop right       
#define TAB_RT      &kp LC(TAB)          // tab switcher forward/right
#define TAB_LT      &kp LC(LS(TAB))      // tab switcher left/back
#define DSK_MGR     &kp LA(GRAVE)       // desktop manager

//Extra key binds
// #define EP &ext_power   // shorten keybind
#define ON &ext_power EP_ON 
#define OFF &ext_power EP_OFF
#define CCOPY C_AC_COPY
#define CPASTE C_AC_PASTE
#define CUNDO C_AC_UNDO
#define CREDO C_AC_REDO

// #define SWP_POS 
// behaviour customization
&sk {
    // timeout-term-ms = <900>;
    release-after-ms = <900>;   // release after 0.9 seconds
    quick-release;              // avoid double capitalization when rolling keys
    
};

&mt {
    flavor = "hold-preferred";
    tapping-term-ms = <200>;
};

&lt {
    flavor = "balanced";
    tapping-term-ms = <200>;
    quick-tap-ms = <QUICK_TAP_MS>;
};

&caps_word {
    continue-list = <UNDERSCORE MINUS BSPC DEL N1 N2 N3 N4 N5 N6 N7 N8 N9 N0>;
};

#include "zmk-includes/combos.dtsi"
#include "zmk-includes/leaders.dtsi"
#include "extra_keys.h"
#include "zmk-includes/extra_defines.h"


// tap: num-word | double-tap: sticky num-layer | hold: num-layer
#define SMART_NUM &smart_num NUM 0
ZMK_HOLD_TAP(smart_num,
    flavor = "balanced";
    tapping-term-ms = <200>;
    quick-tap-ms = <QUICK_TAP_MS>;
    bindings = <&mo>, <&num_dance>;
)
ZMK_TAP_DANCE(num_dance,
    tapping-term-ms = <200>;
    bindings = <&num_word NUM>, <&sl NUM>;  // reverse this for sticky-num on single tap
)

// tap: backspace | lshft + tap: delete | rshft + tap: shift-delete
ZMK_MOD_MORPH(bs_del,
    bindings = <&kp BSPC>, <&kp DEL>;
    mods = <(MOD_LSFT|MOD_RSFT)>;
    keep-mods = <MOD_RSFT>;
)

ZMK_MOD_MORPH(smrt_shft,
    bindings = <&sk LSFT>, <&caps_word>;
    mods = <(MOD_RSFT)>;
)
// tap: space | shift + tap: dot -> space -> sticky shift | hold: activate layer
ZMK_HOLD_TAP(lt_spc,
    flavor = "balanced";
    tapping-term-ms = <200>;
    quick-tap-ms = <QUICK_TAP_MS>;
    bindings = <&mo>, <&spc_morph>;
)

// reuse basic mod-morph scheme
#define SIMPLE_MORPH(NAME, MOD, BINDING1, BINDING2) \
    ZMK_MOD_MORPH(NAME, \
        mods = <(MOD_L ## MOD|MOD_R ## MOD)>; \
        bindings = <BINDING1>, <BINDING2>; \
    )

// SIMPLE_MORPH(spc_morph, SFT, &kp SPACE, &dot_spc)

ZMK_MOD_MORPH(spc_morph,
    mods = <(MOD_LSFT|MOD_RSFT)>;
    bindings = <&kp SPACE>,<&dot_spc>;
)
ZMK_MACRO(dot_spc,
    wait-ms = <0>;
    tap-ms = <5>;
    bindings = <&kp DOT &kp SPACE &sk LSHFT>;
)


/ {
    behaviors {
        skapp: sticky_key_app_switcher {
            compatible = "zmk,behaviour-sticky-key";
            #binding-cells = <1>;
            bindings = <&kp>;
            release-after-ms = <900>;
        };
    };

    // macros
    // macros {

    // };


    // keymap visual
     /* 
          ╭───────────────────────╮         ╭───────────────────────╮
          │      0   1   2   3   4│         │ 5   6   7   8   9     │
          │     10  11  12  13  14│         │25  16  17  18  19     │
          │     20  21  22  23  24 ───╮ ╭─── 25  26  27  28  29     │
          ╰─────────────────╮  30  31 │ │ 32  33 ╭──────────────────╯
                            ╰─────────╯ ╰────────╯           
        */
    keymap {
        compatible = "zmk,keymap";

        default_layer {
            display-name = "DEF";

            bindings = <
/* ╭──────╮ ╭─────────────┬─────────────┬─────────────┬─────────────┬─────────────╮ ╭──────╮ ╭─────────────┬─────────────┬─────────────┬─────────────┬─────────────╮ ╭──────╮ */
    X_LT     &kp Q         &kp W         &kp E         &kp R         &kp T            X_MT    &kp Y         &kp U         &kp I         &kp O         &kp P            X_RT                                                         
/* ├──────┤ ├─────────────┼─────────────┼─────────────┼─────────────┼─────────────┤ ├──────┤ ├─────────────┼─────────────┼─────────────┼─────────────┼─────────────┤ ├──────┤ */
    X_LM     &hgl LGUI A   &hml LALT S   &hml LCTRL D  &hml LSHFT F  &kp G            X_MM    &kp H         &hmr RSHFT J  &hmr LCTRL K  &hmr LALT L   &hgr LGUI SEMI   X_RM
/* ├──────┤ ├─────────────┼─────────────┼─────────────┼─────────────┼─────────────┤ ├──────┤ ├─────────────┼─────────────┼─────────────┼─────────────┼─────────────┤ ├──────┤ */
    X_LB     &kp Z         &kp X         &kp C         &kp V         &kp B            X_MB    &kp N         &kp M         &kp COMMA     &kp DOT       &kp FSLH         X_RB
/* ├──────┤ ╰─────────────┼─────────────┴─────────────┼─────────────┼─────────────┤ ├──────┤ ├─────────────┼─────────────┼─────────────┴───────────────────────────╯ ├──────┤ */
    X_LH                                               &lt NAV SPACE &lt SYM RET      X_MH    SMART_NUM     &smrt_shft                                                 X_RH
/* ╰──────╯                                           ╰─────────────┴─────────────╯ ╰──────╯ ╰─────────────┴─────────────╯                                           ╰──────╯ */
            >;
        };

        cole_layer {
            display-name = "COL_DH";    // Colemak mod DH keymap
			bindings = <
/* ╭──────╮ ╭─────────────┬─────────────┬─────────────┬─────────────┬─────────────╮ ╭──────╮ ╭─────────────┬─────────────┬─────────────┬─────────────┬─────────────╮ ╭──────╮ */
    X_LT     &kp Q         &kp W         &kp F         &kp P         &kp B            X_MT    &kp J         &kp L         &kp U         &kp Y         &kp SEMI         X_RT                                                         
/* ├──────┤ ├─────────────┼─────────────┼─────────────┼─────────────┼─────────────┤ ├──────┤ ├─────────────┼─────────────┼─────────────┼─────────────┼─────────────┤ ├──────┤ */
    X_LM     &hgl LGUI A   &hml LALT R   &hml LCTRL S  &hml LSHFT T  &kp G            X_MM    &kp M         &hmr RSHFT N  &hmr LCTRL E  &hmr LALT I   &hgr LGUI O      X_RM
/* ├──────┤ ├─────────────┼─────────────┼─────────────┼─────────────┼─────────────┤ ├──────┤ ├─────────────┼─────────────┼─────────────┼─────────────┼─────────────┤ ├──────┤ */
    X_LB     &kp Z         &kp X         &kp C         &kp D         &kp V            X_MB    &kp K         &kp H         &kp COMMA     &kp DOT       &kp FSLH         X_RB
/* ├──────┤ ╰─────────────┼─────────────┴─────────────┼─────────────┼─────────────┤ ├──────┤ ├─────────────┼─────────────┼─────────────┴───────────────────────────╯ ├──────┤ */
    X_LH                                               &lt NAV SPACE &lt SYM RET      X_MH    SMART_NUM     &smrt_shft                                                 X_RH
/* ╰──────╯                                           ╰─────────────┴─────────────╯ ╰──────╯ ╰─────────────┴─────────────╯                                           ╰──────╯ */
    		>;
        };

        symbol_layer {
            display-name = "SYM";
            bindings = <
/* ╭──────╮ ╭─────────────┬─────────────┬─────────────┬─────────────┬─────────────╮ ╭──────╮ ╭─────────────┬─────────────┬─────────────┬─────────────┬─────────────╮ ╭──────╮ */
    X_LT     &kp EXCL      &kp AT        &kp HASH      &kp DLLR      &kp PRCNT        X_MT    ___           ___           ___           ___           ___              X_RT
/* ├──────┤ ├─────────────┼─────────────┼─────────────┼─────────────┼─────────────┤ ├──────┤ ├─────────────┼─────────────┼─────────────┼─────────────┼─────────────┤ ├──────┤ */
    X_LM     &kp PLUS      &kp EQUAL     &kp UNDER     &kp MINUS     &kp CARET        X_MM    ___           ___           ___           ___           ___              X_RM
/* ├──────┤ ├─────────────┼─────────────┼─────────────┼─────────────┼─────────────┤ ├──────┤ ├─────────────┼─────────────┼─────────────┼─────────────┼─────────────┤ ├──────┤ */
    X_LB     &kp SQT       &kp PIPE      &kp STAR      &kp AMPS      &kp DQT          X_MB    ___           ___           ___           ___           ___              X_RB  
/* ├──────┤ ╰─────────────┼─────────────┴─────────────┼─────────────┼─────────────┤ ├──────┤ ├─────────────┼─────────────┼─────────────┴───────────────────────────╯ ├──────┤ */
    X_LH                                               ___           ___              X_MH    ___           ___                                                        X_RH
/* ╰──────╯                                           ╰─────────────┴─────────────╯ ╰──────╯ ╰─────────────┴─────────────╯                                           ╰──────╯ */
            >;
        };

        num_layer {
            display-name = "NUM";
            bindings = <
/* ╭──────╮ ╭─────────────┬─────────────┬─────────────┬─────────────┬─────────────╮ ╭──────╮ ╭─────────────┬─────────────┬─────────────┬─────────────┬─────────────╮ ╭──────╮ */
    X_LT     &kp SLASH     &kp N7        &kp N8        &kp N9        &kp GRAVE        X_MT    ___           ___           ___           ___           ___              X_RT
/* ├──────┤ ├─────────────┼─────────────┼─────────────┼─────────────┼─────────────┤ ├──────┤ ├─────────────┼─────────────┼─────────────┼─────────────┼─────────────┤ ├──────┤*/
    X_LM     &kp N0        &kp N4        &kp N5        &kp N6        &kp DOT          X_MM    ___           ___           ___           ___           ___              X_RM
/* ├──────┤ ├─────────────┼─────────────┼─────────────┼─────────────┼─────────────┤ ├──────┤ ├─────────────┼─────────────┼─────────────┼─────────────┼─────────────┤ ├──────┤*/
    X_LB     &kp SEMI      &kp N1        &kp N2        &kp N3        &kp BSLH         X_MB    ___           ___           ___           ___           ___              X_RB
/* ├──────┤ ╰─────────────┼─────────────┴─────────────┼─────────────┼─────────────┤ ├──────┤ ├─────────────┼─────────────┼─────────────┴───────────────────────────╯ ├──────┤ */
    X_LH                                               ___           ___              X_MH    ___           ___                                                        X_RH
/* ╰──────╯                                           ╰─────────────┴─────────────╯ ╰──────╯ ╰─────────────┴─────────────╯                                           ╰──────╯ */
            >;
 
        };

        nav_layer {
            display-name = "NAV";
            bindings = <
/* ╭──────╮ ╭─────────────┬─────────────┬─────────────┬─────────────┬─────────────╮ ╭──────╮ ╭─────────────┬─────────────┬─────────────┬─────────────┬─────────────╮ ╭──────╮ */
     X_LT    &kp LA(F4)    ___           ___           ___           &kp C_VOL_UP     X_MT    &kp PG_UP     NAV_BSPC      &kp UP        NAV_DEL       &kp HOME         X_RT
/* ├──────┤ ├─────────────┼─────────────┼─────────────┼─────────────┼─────────────┤ ├──────┤ ├─────────────┼─────────────┼─────────────┼─────────────┼─────────────┤ ├──────┤ */
     X_LM    &kp LGUI      &kp LALT      &kp LCTRL     &mt LSHFT TAB &kp C_VOL_DN     X_MM    &kp PG_DN     &kp LEFT      &kp DOWN      &kp RIGHT     &kp END          X_RM
/* ├──────┤ ├─────────────┼─────────────┼─────────────┼─────────────┼─────────────┤ ├──────┤ ├─────────────┼─────────────┼─────────────┼─────────────┼─────────────┤ ├──────┤ */
     X_LB    &kp LC(F4)    TAB_LT        TAB_RT        &kp LS(INS)      XXX           X_MB    &kp INS       ___           ___           ___           XXX              X_RB  
/* ├──────┤ ╰─────────────┼─────────────┴─────────────┼─────────────┼─────────────┤ ├──────┤ ├─────────────┼─────────────┼─────────────┴───────────────────────────╯ ├──────┤ */
     X_LH                                              XXX           ___              X_MH    ___           ___                                                        X_RH
/* ╰──────╯                                           ╰─────────────┴─────────────╯ ╰──────╯ ╰─────────────┴─────────────╯                                           ╰──────╯ */

            >;

        };

        fun_layer {
            display-name = "FUN";
            bindings = <
/* ╭──────╮ ╭─────────────┬─────────────┬─────────────┬─────────────┬─────────────╮ ╭──────╮ ╭─────────────┬─────────────┬─────────────┬─────────────┬─────────────╮ ╭──────╮ */
    X_LT     &kp F1        &kp F2        &kp F3        &kp F4        &kp F5           X_MT    &kp CREDO     &kp CCOPY     &kp C_VOL_UP  XXX           XXX              X_RT                                                             
/* ├──────┤ ├─────────────┼─────────────┼─────────────┼─────────────┼─────────────┤ ├──────┤ ├─────────────┼─────────────┼─────────────┼─────────────┼─────────────┤ ├──────┤ */
    X_LM     &kp LGUI      &kp LALT      &kp LCTRL     &kp LSHFT     &kp F11          X_MM    &kp CUNDO     &kp CPASTE    &kp C_VOL_DN  XXX           XXX              X_RM
/* ├──────┤ ├─────────────┼─────────────┼─────────────┼─────────────┼─────────────┤ ├──────┤ ├─────────────┼─────────────┼─────────────┼─────────────┼─────────────┤ ├──────┤ */
    X_LB     &kp F6        &kp F7        &kp F8        &kp F9        &kp F10          X_MB    &kp CAPS      &kp C_PREV    &kp C_PP      &kp C_NEXT    &to SYS          X_RB
/* ├──────┤ ╰─────────────┼─────────────┴─────────────┼─────────────┼─────────────┤ ├──────┤ ├─────────────┼─────────────┼─────────────┴───────────────────────────╯ ├──────┤ */
    X_LH                                               XXX           ___              X_MH    ___           XXX                                                        X_RH                            
/* ╰──────╯                                           ╰─────────────┴─────────────╯ ╰──────╯ ╰─────────────┴─────────────╯                                           ╰──────╯ */
            >;

        };

        sys_layer {
            display-name = "SYS";
            bindings = <
/* ╭──────╮ ╭─────────────┬─────────────┬─────────────┬─────────────┬─────────────╮ ╭──────╮ ╭─────────────┬─────────────┬─────────────┬─────────────┬─────────────╮ ╭──────╮ */
    X_LT     XXX           XXX           XXX           &out OUT_BLE  &out OUT_USB     X_MT    &bt BT_PRV    &bt BT_NXT    XXX           XXX           &studio_unlock   X_RT                                                         
/* ├──────┤ ├─────────────┼─────────────┼─────────────┼─────────────┼─────────────┤ ├──────┤ ├─────────────┼─────────────┼─────────────┼─────────────┼─────────────┤ ├──────┤ */
    X_LM     &kp C_PWR     XXX           XXX           &kp C_BRI_INC XXX              X_MM    &bt BT_SEL 0  &bt BT_SEL 1  &bt BT_SEL 2  &bt BT_SEL 3  &bt BT_SEL 4     X_RM
/* ├──────┤ ├─────────────┼─────────────┼─────────────┼─────────────┼─────────────┤ ├──────┤ ├─────────────┼─────────────┼─────────────┼─────────────┼─────────────┤ ├──────┤ */
    X_LB     &bt BT_CLR    XXX           XXX           &kp C_BRI_DEC XXX              X_MB    OFF           ON            XXX           &to COL_DH    &to DEF          X_RB
/* ├──────┤ ╰─────────────┼─────────────┴─────────────┼─────────────┼─────────────┤ ├──────┤ ├─────────────┼─────────────┼─────────────┴───────────────────────────╯ ├──────┤ */
    X_LH                                               XXX           ___              X_MH    ___           XXX                                                        X_RH                            
/* ╰──────╯                                           ╰─────────────┴─────────────╯ ╰──────╯ ╰─────────────┴─────────────╯                                           ╰──────╯ */
            >;

        };
        overcooked_layer {
            display-name = "OVERCOOKED";
            bindings = <
/* ╭──────╮ ╭─────────────┬─────────────┬─────────────┬─────────────┬─────────────╮ ╭──────╮ ╭─────────────┬─────────────┬─────────────┬─────────────┬─────────────╮ ╭──────╮ */
    X_LT     &kp Q         &kp W         &kp E         &kp R         &kp T            X_MT    &kp Y         &kp U         &kp I         &kp O         &kp P            X_RT 
/* ├──────┤ ├─────────────┼─────────────┼─────────────┼─────────────┼─────────────┤ ├──────┤ ├─────────────┼─────────────┼─────────────┼─────────────┼─────────────┤ ├──────┤ */
    X_LM     &kp A         &kp S         &kp D         &kp F         &kp G            X_MM    &kp H         &kp J         &kp K         &kp L         &kp SEMI         X_RM
/* ├──────┤ ├─────────────┼─────────────┼─────────────┼─────────────┼─────────────┤ ├──────┤ ├─────────────┼─────────────┼─────────────┼─────────────┼─────────────┤ ├──────┤ */
    X_LB     &kp Z         &kp X         &kp C         &kp V         &kp B            X_MB    &kp N         &kp M         &kp COMMA     &kp DOT       &kp FSLH         X_RB
/* ├──────┤ ╰─────────────┼─────────────┴─────────────┼─────────────┼─────────────┤ ├──────┤ ├─────────────┼─────────────┼─────────────┴───────────────────────────╯ ├──────┤ */
    X_LH                                               &kp SPC       &kp RET          X_MH    SMART_NUM     &smrt_shft                                                 X_RH
/* ╰──────╯                                           ╰─────────────┴─────────────╯ ╰──────╯ ╰─────────────┴─────────────╯                                           ╰──────╯ */
            >;
        };
        extra_layer_1 {
            status = "reserved";
           // display-name = "EXT1";
           // bindings = <

           // >;
        };
        extra_layer_2 {
            status = "reserved";
            // display-name = "EXT2";
            // bindings = <

            // >;
        };
    };
};

// Layer Template
/* ╭──────╮ ╭─────────────┬─────────────┬─────────────┬─────────────┬─────────────╮ ╭──────╮ ╭─────────────┬─────────────┬─────────────┬─────────────┬─────────────╮ ╭──────╮ */
    // X_LT     X_MT    X_RT                                                         
/* ├──────┤ ├─────────────┼─────────────┼─────────────┼─────────────┼─────────────┤ ├──────┤ ├─────────────┼─────────────┼─────────────┼─────────────┼─────────────┤ ├──────┤ */
    // X_LM     X_MM    X_RM
/* ├──────┤ ├─────────────┼─────────────┼─────────────┼─────────────┼─────────────┤ ├──────┤ ├─────────────┼─────────────┼─────────────┼─────────────┼─────────────┤ ├──────┤ */
    // X_LB     X_MB    X_RB
/* ├──────┤ ╰─────────────┼─────────────┴─────────────┼─────────────┼─────────────┤ ├──────┤ ├─────────────┼─────────────┼─────────────┴───────────────────────────╯ ├──────┤ */
    // X_LH     X_MH    X_RH
/* ╰──────╯                                           ╰─────────────┴─────────────╯ ╰──────╯ ╰─────────────┴─────────────╯                                           ╰──────╯ */
// This file has been taken from urob's zmk-config
// original can be found here: https://github.com/urob/zmk-config/blob/main/config/combos.dtsi

// The user must ensure that any combos they wish to implement mention layers that exist in their keymap
/*                KEY POSITIONS

  ╭─────────────────────╮ ╭─────────────────────╮
  │ LT4 LT3 LT2 LT1 LT0 │ │ RT0 RT1 RT2 RT3 RT4 │
  │ LM4 LM3 LM2 LM1 LM0 │ │ RM0 RM1 RM2 RM3 RM4 │
  │ LB4 LB3 LB2 LB1 LB0 │ │ RB0 RB1 RB2 RB3 RB4 │
  ╰───────────╮ LH1 LH0 │ │ RH0 RH1 ╭───────────╯
              ╰─────────╯ ╰─────────╯ */
// ensure all layers mentioned here have been defined in the .keymap file
#ifndef DEF
    #define DEF 0
#endif
#ifndef COL_DH
    #define COL_DH 1
#endif
#ifndef SYM
    #define SYM 2       // Commonly used symbols
#endif
#ifndef NAV
    #define NAV 3       // arrow keys, PGUP/PGDN, back, forward, window swappers, 
#endif
#ifndef FUN
    #define FUN 4       // F keys, print screen, insert, etc.
#endif
#ifndef SYS
    #define SYS 5   
#endif
// Define user keymap layers (layers for character combos)

#define MAPS DEF COL_DH 

// Timeout terms (ms) for the combo (smaller value == harder to trigger, kp's must be more synchronized)
#define COMBO_TERM_FAST 18
#define COMBO_TERM_SLOW 30

// the following 'IDLE' definitions specify a time in which no non-combo keys can be pressed
// if any non-modifier key is pressed in this time BEFORE a key in the combo, the combo will not trigger

#define COMBO_IDLE_FAST 150
#define COMBO_IDLE_SLOW 50

/* Left hand combos */
ZMK_COMBO(lpar, &kp LPAR, LM2 LM1, MAPS, COMBO_TERM_SLOW, COMBO_IDLE_SLOW)  // left parenthesis: (
ZMK_COMBO(lbrk, &kp LBKT, LM3 LM2, MAPS, COMBO_TERM_SLOW, COMBO_IDLE_SLOW)  // left bracket (+ shift for left brace): [ ( { )
ZMK_COMBO(bslh, &kp BSLH, LB4 LB3, MAPS, COMBO_TERM_SLOW, COMBO_IDLE_SLOW) // backslash
ZMK_COMBO(esc,  &kp ESC,  LT3 LT2, MAPS, COMBO_TERM_FAST, COMBO_IDLE_FAST) // escape
ZMK_COMBO(tld,  &kp TILDE,LT4 LT3, MAPS, COMBO_TERM_FAST, COMBO_IDLE_FAST) // tilde 


/* right hand combos*/
ZMK_COMBO(rpar, &kp RPAR, RM2 RM1, MAPS, COMBO_TERM_SLOW, COMBO_IDLE_SLOW)  // right parenthesis
ZMK_COMBO(rbrk, &kp RBKT, RM3 RM2, MAPS, COMBO_TERM_SLOW, COMBO_IDLE_SLOW)  // right bracket/brace
ZMK_COMBO(fslh,  &kp FSLH, RM2 RB2, MAPS, COMBO_TERM_SLOW, COMBO_IDLE_SLOW) // forward slash
ZMK_COMBO(bslh, &kp BSLH, RT4 RT3, MAPS, COMBO_TERM_SLOW, COMBO_IDLE_SLOW) // backslash

// Layer Shifts
ZMK_COMBO(col2def, &to DEF, LM4 RM4, COL_DH, COMBO_TERM_FAST, COMBO_IDLE_FAST) // return to default qwerty layout from col_dh layer
ZMK_COMBO(def2col, &to COL_DH, LM4 RM4, DEF, COMBO_TERM_FAST, COMBO_IDLE_FAST) // switch to col_dh from default layer
/* NAV Layer combos */
/* Left hand combos */
ZMK_COMBO(d_lt, D_LT, LT3 LT2, NAV, COMBO_TERM_FAST, COMBO_IDLE_FAST) // switch to desktop on left
ZMK_COMBO(d_rt, D_RT, LT2 LT1, NAV, COMBO_TERM_FAST, COMBO_IDLE_FAST) // switch to desktop on right

/* Right hand combos */
ZMK_COMBO(rw, &kp C_RW, RB1 RB2, NAV, COMBO_TERM_FAST, COMBO_IDLE_FAST) // rewind
ZMK_COMBO(ff, &kp C_FF, RB2 RB3, NAV, COMBO_TERM_FAST, COMBO_IDLE_FAST) // fast forward



/* Horizontal combos - left hand */
// ZMK_COMBO(esc,   &kp ESC,      LT3 LT2,     DEF NAV NUM, COMBO_TERM_FAST, COMBO_IDLE_FAST)
// ZMK_COMBO(ret,   &kp RETURN,   LT2 LT1,     DEF NAV NUM, COMBO_TERM_FAST, COMBO_IDLE_FAST)
// ZMK_COMBO(mouse, &smart_mouse, LT3 LT1,     DEF NAV NUM, COMBO_TERM_FAST, COMBO_IDLE_FAST)

// Combos overlapping HRMs are set up as hold-taps themselves to allow for instantaneous
// chording of mods. Custom hold-tap instances can be bootstrapped on the go using the
// 8-argument version of ZMK_COMBO defined in base.keymap.
// ZMK_COMBO(tab,   &hml LS(LALT)TAB, LM3 LM2, DEF NAV NUM, COMBO_TERM_FAST, COMBO_IDLE_FAST)
// ZMK_COMBO(ldr,   &leader,      LM2 LM1,     DEF NAV NUM, COMBO_TERM_FAST, COMBO_IDLE_FAST, LS(LCTRL),    KEYS_R)
// ZMK_COMBO(ldrsh, &leader_sft,  LM3 LM2 LM1, DEF NAV NUM, COMBO_TERM_FAST, COMBO_IDLE_FAST, LS(LC(LALT)), KEYS_R)

// ZMK_COMBO(cut,   &kp LC(X),    LB3 LB1,     DEF NAV NUM, COMBO_TERM_FAST, COMBO_IDLE_FAST)
// ZMK_COMBO(copy,  &kp LC(INS),  LB3 LB2,     DEF NAV NUM, COMBO_TERM_FAST, COMBO_IDLE_FAST)
// ZMK_COMBO(paste, &kp LS(INS),  LB2 LB1,     DEF NAV NUM, COMBO_TERM_FAST, COMBO_IDLE_FAST)

// /* Horizontal combos - right hand */
// ZMK_COMBO(bspc,  &kp BSPC,     RT1 RT2,     DEF NAV NUM, COMBO_TERM_FAST, COMBO_IDLE_FAST)
// ZMK_COMBO(del,   &kp DEL,      RT2 RT3,     DEF NAV NUM, COMBO_TERM_FAST, COMBO_IDLE_FAST)

// ZMK_COMBO(lpar,  &lpar_lt,     RM1 RM2,     DEF     NUM, COMBO_TERM_FAST, COMBO_IDLE_FAST, RS(LCTRL),    KEYS_L)
// ZMK_COMBO(rpar,  &rpar_gt,     RM2 RM3,     DEF     NUM, COMBO_TERM_FAST, COMBO_IDLE_FAST, RS(LALT),     KEYS_L)
// ZMK_COMBO(lt,    &kp LT,       RM1 RM2,         NAV    , COMBO_TERM_FAST, COMBO_IDLE_FAST)
// ZMK_COMBO(gt,    &kp GT,       RM2 RM3,         NAV    , COMBO_TERM_FAST, COMBO_IDLE_FAST)

// ZMK_COMBO(lbkt,  &kp LBKT,     RB1 RB2,     DEF     NUM, COMBO_TERM_FAST, COMBO_IDLE_FAST)
// ZMK_COMBO(rbkt,  &kp RBKT,     RB2 RB3,     DEF     NUM, COMBO_TERM_FAST, COMBO_IDLE_FAST)
// ZMK_COMBO(lbrc,  &kp LBRC,     RB1 RB2,         NAV    , COMBO_TERM_FAST, COMBO_IDLE_FAST)
// ZMK_COMBO(rbrc,  &kp RBRC,     RB2 RB3,         NAV    , COMBO_TERM_FAST, COMBO_IDLE_FAST)

// /* Vertical combos - left hand */
// ZMK_COMBO(at,    &kp AT,       LT3 LM3,     DEF NAV NUM, COMBO_TERM_SLOW, COMBO_IDLE_SLOW)
// ZMK_COMBO(hash,  &kp HASH,     LT2 LM2,     DEF NAV NUM, COMBO_TERM_SLOW, COMBO_IDLE_SLOW)
// ZMK_COMBO(dllr,  &kp DLLR,     LT1 LM1,     DEF NAV NUM, COMBO_TERM_SLOW, COMBO_IDLE_SLOW)
// ZMK_COMBO(prcnt, &kp PRCNT,    LT0 LM0,     DEF NAV NUM, COMBO_TERM_SLOW, COMBO_IDLE_SLOW)

// ZMK_COMBO(grave, &kp GRAVE,    LM3 LB3,     DEF NAV NUM, COMBO_TERM_SLOW, COMBO_IDLE_SLOW)
// ZMK_COMBO(bslh,  &kp BSLH,     LM2 LB2,     DEF NAV NUM, COMBO_TERM_SLOW, COMBO_IDLE_SLOW)
// ZMK_COMBO(equal, &kp EQUAL,    LM1 LB1,     DEF NAV NUM, COMBO_TERM_SLOW, COMBO_IDLE_SLOW)
// ZMK_COMBO(tilde, &kp TILDE,    LM0 LB0,     DEF NAV NUM, COMBO_TERM_SLOW, COMBO_IDLE_SLOW)

// /* Vertical combos - right hand */
// ZMK_COMBO(caret, &kp CARET,    RT0 RM0,     DEF NAV NUM, COMBO_TERM_SLOW, COMBO_IDLE_SLOW)
// ZMK_COMBO(plus,  &kp PLUS,     RT1 RM1,     DEF NAV NUM, COMBO_TERM_SLOW, COMBO_IDLE_SLOW)
// ZMK_COMBO(star,  &kp STAR,     RT2 RM2,     DEF NAV NUM, COMBO_TERM_SLOW, COMBO_IDLE_SLOW)
// ZMK_COMBO(amps,  &kp AMPS,     RT3 RM3,     DEF NAV NUM, COMBO_TERM_SLOW, COMBO_IDLE_SLOW)

// ZMK_COMBO(under, &kp UNDER,    RM0 RB0,     DEF NAV NUM, COMBO_TERM_SLOW, COMBO_IDLE_SLOW)
// ZMK_COMBO(minus, &kp MINUS,    RM1 RB1,     DEF NAV NUM, COMBO_TERM_SLOW, COMBO_IDLE_SLOW)
// ZMK_COMBO(fslh,  &kp FSLH,     RM2 RB2,     DEF NAV NUM, COMBO_TERM_SLOW, COMBO_IDLE_SLOW)
// ZMK_COMBO(pipe,  &kp PIPE,     RM3 RB3,     DEF NAV NUM, COMBO_TERM_SLOW, COMBO_IDLE_SLOW)
