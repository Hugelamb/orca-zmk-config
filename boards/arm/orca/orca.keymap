/* 
 *  Created by Hugh Lam (2024)
 *
 *  orca keymap
 */

#include <behaviors.dtsi>
#include <dt-bindings/zmk/keys.h>
#include <dt-bindings/zmk/bt.h>
#include <dt-bindings/zmk/ext_power.h>
#include <dt-bindings/zmk/rgb.h>
#include <dt-bindings/zmk/outputs.h>

// non-standard modules

#include "input.h"    // Japanese input module behaviors-kana
#define HOST_OS 1

#include "zmk-includes/helper.h"
#include "zmk-includes/34.h"
#include <behaviors/num_word.dtsi>  // add num_word behaviour by urob, from https://github.com/urob/zmk-auto-layer.git repository
#include "orca-layouts.dtsi"     // uncomment once the config supports ZMK Studio 
// Unicode combos
//#include "zmk-includes/greek.dtsi"
#include "zmk-includes/math.dtsi"
#include "zmk-helpers/unicode-chars/german.dtsi"
#include "zmk-helpers/unicode-chars/greek.dtsi"

// use helper macros to define left and right hand positions
#define KEYS_L LT0 LT1 LT2 LT3 LT4 LM0 LM1 LM2 LM3 LM4 LB0 LB1 LB2 LB3 LB4  // left-hand keys
#define KEYS_R RT0 RT1 RT2 RT3 RT4 RM0 RM1 RM2 RM3 RM4 RB0 RB1 RB2 RB3 RB4  // right-hand keys
#define THUMBS LH1 LH0 RH0 RH1 

#define XXX &none
#define ___ &trans

/* Global Settings */
#define QUICK_TAP_MS 175

// urob's Timeless HRM's
#define MAKE_HRM(NAME, HOLD, TAP, TRIGGER_POS) \
    ZMK_HOLD_TAP(NAME, \
        flavor = "balanced"; \
        tapping-term-ms = <280>; \
        quick-tap-ms = <QUICK_TAP_MS>; \
        require-prior-idle-ms = <150>; \
        bindings = <HOLD>, <TAP>; \
        hold-trigger-key-positions = <TRIGGER_POS>; \
        hold-trigger-on-release; \
    )
MAKE_HRM(hml, &kp, &kp, KEYS_R THUMBS)  // left-hand HRMs
MAKE_HRM(hmr, &kp, &kp, KEYS_L THUMBS)  // right-hand HRMs

// HRM with changed timeouts for gui only
// tapping-term-ms : 280 >> 350
// quick-tap-ms : 175 >> 200
// require-prior-idle-ms : 150 >> 150
#define MAKE_HR_GUI(NAME, HOLD, TAP, TRIGGER_POS) \
    ZMK_HOLD_TAP(NAME, \
        flavor = "balanced"; \
        tapping-term-ms = <350>; \
        quick-tap-ms = <200>; \
        require-prior-idle-ms = <150>; \
        bindings = <HOLD>, <TAP>; \
        hold-trigger-key-positions = <TRIGGER_POS>; \
        hold-trigger-on-release; \
    )

MAKE_HR_GUI(hgl, &kp, &kp,KEYS_R THUMBS) // left-hand GUI
MAKE_HR_GUI(hgr, &kp, &kp,KEYS_L THUMBS) // right-hand GUI

// Layer defines

#define DEF 0
#define NIC 1       // NICOLA Anthy Layer 
#define HIR 2       // Hiragana layer (Nicola Thumb shift)
#define KAT 3       // Katakana layer
#define COL_DH 4
#define GME 5       // Gaming Layer, QWERTY with home row mods disabled.
#define COLTYPE 6   // Colemak DH Gaming Layer for Epistory typing tool.
#define SYM 7       // Commonly used symbols
#define NUM 8
#define NAV 9       // arrow keys, PGUP/PGDN, back, forward, window swappers, 
#define FUN 10       // F keys, print screen, insert, etc.
#define SYS 11       // Board related functions, BT profiles, reset, bootloader, ext power cutoff.
// #define MOU 6
// Conditional layer change
ZMK_CONDITIONAL_LAYER(fun, NAV SYM, FUN)  // NAV + SYM => FUN

// HYPR key for hyprland keybinds 
#define HYPR        LG(LA(LS(LCTRL)))   // GUI + ALT + SHIFT + CTRL = HYPR
// NAV Layer macros
#define NAV_BSPC    &mt LC(BSPC) BSPC   // tap: backspace | long-tap: delete word backwards
#define NAV_DEL     &mt LC(DEL) DEL     // tap: delete | long-tap: delete word forwards

// Desktop window management and tab nav shortcuts
#define D_LT        &kp LG(LC(LEFT))     // move desktop left
#define D_RT        &kp LG(LC(RIGHT))    // move desktop right       
#define TAB_RT      &kp LC(TAB)          // tab switcher forward/right
#define TAB_LT      &kp LC(LS(TAB))      // tab switcher left/back
#define DSK_MGR     &kp LA(GRAVE)       // desktop manager

//Extra key binds
// #define EP &ext_power   // shorten keybind
#define ON &ext_power EP_ON 
#define OFF &ext_power EP_OFF

// #define SWP_POS 
// behaviour customization
&sk {
    // timeout-term-ms = <900>;
    release-after-ms = <500>;   // release after 0.9 seconds
    quick-release;              // avoid double capitalization when rolling keys
    
};

&mt {
    flavor = "hold-preferred";
    tapping-term-ms = <200>;
};

&lt {
    flavor = "balanced";
    tapping-term-ms = <200>;
    //quick-tap-ms = <QUICK_TAP_MS>;
};

&caps_word {
    continue-list = <UNDERSCORE BSPC DEL N1 N2 N3 N4 N5 N6 N7 N8 N9 N0>;
};

// include extra combo and key definitions
#include "leader.dtsi"
#include "zmk-includes/combos.dtsi"
#include "zmk-includes/leaders.dtsi"
#include "extra_keys.h"
#include "zmk-includes/extra_defines.h"
#include "nicola.dtsi"

// tap: num-word | double-tap: sticky num-layer | hold: num-layer
#define SMART_NUM &smart_num NUM 0
ZMK_HOLD_TAP(smart_num,
    flavor = "balanced";
    tapping-term-ms = <200>;
    quick-tap-ms = <QUICK_TAP_MS>;
    bindings = <&mo>, <&num_dance>;
)
ZMK_TAP_DANCE(num_dance,
    tapping-term-ms = <200>;
    bindings = <&num_word NUM>, <&sl NUM>;  // reverse this for sticky-num on single tap
)

// tap: backspace | lshft + tap: delete | rshft + tap: shift-delete
ZMK_MOD_MORPH(bs_del,
    bindings = <&kp BSPC>, <&kp DEL>;
    mods = <(MOD_LSFT|MOD_RSFT)>;
    keep-mods = <MOD_RSFT>;
)

// separate left/right shift capsword commands

// japanese kana/hiragana thumb shift keys
ZMK_MOD_MORPH(ret_morph,
  bindings = <&tog KAT>,<&kp RET>;
  mods = <(MOD_LSFT)>;
)
//left shift
ZMK_MOD_MORPH(smrt_shft,
    bindings = <&sk LSFT>, <&caps_word>;
    mods = <(MOD_LSFT|MOD_RSFT)>;
)
// tap: space | shift + tap: dot -> space -> sticky shift | hold: activate layer
ZMK_HOLD_TAP(lt_spc,
    flavor = "balanced";
    tapping-term-ms = <200>;
    quick-tap-ms = <QUICK_TAP_MS>;
    bindings = <&mo>, <&spc_morph>;
)

// reuse basic mod-morph scheme
#define SIMPLE_MORPH(NAME, MOD, BINDING1, BINDING2) \
    ZMK_MOD_MORPH(NAME, \
        mods = <(MOD_L ## MOD|MOD_R ## MOD)>; \
        bindings = <BINDING1>, <BINDING2>; \
    )

// SIMPLE_MORPH(spc_morph, SFT, &kp SPACE, &dot_spc)

ZMK_MOD_MORPH(spc_morph,
    mods = <(MOD_LSFT|MOD_RSFT)>;
    bindings = <&kp SPACE>,<&dot_spc>;
)
ZMK_MACRO(dot_spc,
    wait-ms = <0>;
    tap-ms = <5>;
    bindings = <&kp DOT &kp SPACE &sk LSHFT>;
)

ZMK_HOLD_TAP(cjk_spc,
  flavor = "balanced";
  tapping-term-ms = <200>;
  quick-tap-ms = <QUICK_TAP_MS>;
  bindings = <&mo>, <&ideo_spc>; // requires inclusion of nicola.dtsi from behaviors-kana module
  )
THMB_MACRO(ideo_spc, &kp N3 &kp N0 &kp N0 &kp N0)
/ {
   // behaviors {
   //     skapp: sticky_key_app_switcher {
   //         compatible = "zmk,behaviour-sticky-key";
   //         #binding-cells = <1>;
   //         bindings = <&kp>;
   //         release-after-ms = <900>;
   //     };
   // };

    // macros
    // macros {

    // };


    // keymap visual
     /* 
          ╭───────────────────────╮         ╭───────────────────────╮
          │      0   1   2   3   4│         │ 5   6   7   8   9     │
          │     10  11  12  13  14│         │25  16  17  18  19     │
          │     20  21  22  23  24 ───╮ ╭─── 25  26  27  28  29     │
          ╰─────────────────╮  30  31 │ │ 32  33 ╭──────────────────╯
                            ╰─────────╯ ╰────────╯           
        */
    keymap {
        compatible = "zmk,keymap";
        default_layer { // Layer 0
                    display-name = "DEF"; 
                    bindings = <
/* ╭──────╮ ╭─────────────┬─────────────┬─────────────┬─────────────┬─────────────╮ ╭──────╮ ╭─────────────┬─────────────┬─────────────┬─────────────┬─────────────╮ ╭──────╮ */
    X_LT     &kp Q         &kp W         &kp E         &kp R         &kp T            X_MT    &kp Y         &kp U         &kp I         &kp O         &kp P            X_RT                                                         
/* ├──────┤ ├─────────────┼─────────────┼─────────────┼─────────────┼─────────────┤ ├──────┤ ├─────────────┼─────────────┼─────────────┼─────────────┼─────────────┤ ├──────┤ */
    X_LM     &hgl LGUI A   &hml LALT S   &hml LCTRL D  &hml LSHFT F  &hml HYPR G      X_MM    &hmr HYPR H   &hmr RSHFT J  &hmr LCTRL K  &hmr LALT L   &hgr LGUI SEMI   X_RM
/* ├──────┤ ├─────────────┼─────────────┼─────────────┼─────────────┼─────────────┤ ├──────┤ ├─────────────┼─────────────┼─────────────┼─────────────┼─────────────┤ ├──────┤ */
    X_LB     &kp Z         &kp X         &kp C         &kp V         &kp B            X_MB    &kp N         &kp M         &kp COMMA     &kp DOT       &kp FSLH         X_RB
/* ├──────┤ ╰─────────────┼─────────────┴─────────────┼─────────────┼─────────────┤ ├──────┤ ├─────────────┼─────────────┼─────────────┴───────────────────────────╯ ├──────┤ */
    X_LH                                               &lt NAV SPACE &lt SYM RET      X_MH    SMART_NUM     &smrt_shft                                                 X_RH
/* ╰──────╯                                           ╰─────────────┴─────────────╯ ╰──────╯ ╰─────────────┴─────────────╯                                           ╰──────╯ */
                    >;
                };
    jap_anthy_nicola_layer { // Layer 1
      display-name = "anthy"; 
      bindings = <
    /* ╭──────╮ ╭─────────────┬─────────────┬─────────────┬─────────────┬─────────────╮ ╭──────╮ ╭─────────────┬─────────────┬─────────────┬─────────────┬─────────────╮ ╭──────╮ */
        X_LT     &kp Q         &kp W         &kp E         &kp R         &kp T            X_MT    &kp Y         &kp U         &kp I         &kp O         &kp P            X_RT                                                         
    /* ├──────┤ ├─────────────┼─────────────┼─────────────┼─────────────┼─────────────┤ ├──────┤ ├─────────────┼─────────────┼─────────────┼─────────────┼─────────────┤ ├──────┤ */
        X_LM     &hgl LGUI A   &hml LALT S   &hml LCTRL D  &hml LSHFT F  &hml HYPR G      X_MM    &hmr HYPR H   &hmr RSHFT J  &hmr LCTRL K  &hmr LALT L   &hgr LGUI SEMI   X_RM
    /* ├──────┤ ├─────────────┼─────────────┼─────────────┼─────────────┼─────────────┤ ├──────┤ ├─────────────┼─────────────┼─────────────┼─────────────┼─────────────┤ ├──────┤ */
        X_LB     &kp Z         &kp X         &kp C         &kp V         &kp B            X_MB    &kp N         &kp M         &kp COMMA     &kp DOT       &kp FSLH         X_RB
    /* ├──────┤ ╰─────────────┼─────────────┴─────────────┼─────────────┼─────────────┤ ├──────┤ ├─────────────┼─────────────┼─────────────┴───────────────────────────╯ ├──────┤ */
        X_LH                                               &lt NAV SPACE &sk INT5         X_MH    &sk INT4      &lt SYM INT_KANA                                               X_RH
    /* ╰──────╯                                           ╰─────────────┴─────────────╯ ╰──────╯ ╰─────────────┴─────────────╯                                           ╰──────╯ */
      >;
    };


    jap_nicola_layer_1 { // Layer 2
      display-name = "hiragana";//"にはんご"; // = nihongo (japanese)
      /* format is (default, left shift, right shift)
╭──────╮ ╭─────────────┬─────────────┬─────────────┬─────────────┬─────────────╮ ╭──────╮ ╭─────────────┬─────────────┬─────────────┬─────────────┬─────────────╮ ╭──────╮

├──────┤ ├─────────────┼─────────────┼─────────────┼─────────────┼─────────────┤ ├──────┤ ├─────────────┼─────────────┼─────────────┼─────────────┼─────────────┤ ├──────┤
(。, ,ぁ)     (か,が,え)    (り,だ,)      (こ,ご,ゃ)    (さ,ざ,れ)               (ら,ぱ,よ)    (ち,ぢ,に)    (く,ぐ,る)    (つ,づ,ま)    (, ,ぴ,ぇ)      (、)
├──────┤ ├─────────────┼─────────────┼─────────────┼─────────────┼─────────────┤ ├──────┤ ├─────────────┼─────────────┼─────────────┼─────────────┼─────────────┤ ├──────┤
(う, , を)    (し,じ,あ)    (て,で,な)    (け,げ,ゅ)    (せ,ぜ,も)               (は,ば,み)    (と,ど,お)    (き,ぎ,の)    (い,ぽ,ょ)    (ん, ,っ)
├──────┤ ├─────────────┼─────────────┼─────────────┼─────────────┼─────────────┤ ├──────┤ ├─────────────┼─────────────┼─────────────┼─────────────┼─────────────┤ ├──────┤
(., , ぅ)     (ひ,び,ー)    (す,ず,ろ)    (ふ,ぶ,や)    (へ,べ,ぃ)               (め,ぷ,ぬ)    (そ,ぞ,ゆ)    (ね,ぺ,む)    (ほ,ぼ,わ)    (・, ,ぉ)
*/
      bindings = <
        /* ╭──────╮ ╭─────────────┬─────────────┬─────────────┬─────────────┬─────────────╮ ╭──────╮ ╭─────────────┬─────────────┬─────────────┬─────────────┬─────────────╮ ╭──────╮ */
        X_LT     &ja_h_lt4     &ja_h_lt3     &ja_h_lt2     &ja_h_lt1     &ja_h_lt0        X_MT    &ja_h_rt0     &ja_h_rt1     &ja_h_rt2     &ja_h_rt3     &ja_h_rt4        X_RT 
        /* ├──────┤ ├─────────────┼─────────────┼─────────────┼─────────────┼─────────────┤ ├──────┤ ├─────────────┼─────────────┼─────────────┼─────────────┼─────────────┤ ├──────┤ */
        X_LM     &ja_h_lm4     &ja_h_lm3     &ja_h_lm2     &ja_h_lm1     &ja_h_lm0        X_MM    &ja_h_rm0     &ja_h_rm1     &ja_h_rm2     &ja_h_rm3     &ja_h_rm4        X_RM
        /* ├──────┤ ├─────────────┼─────────────┼─────────────┼─────────────┼─────────────┤ ├──────┤ ├─────────────┼─────────────┼─────────────┼─────────────┼─────────────┤ ├──────┤ */
        X_LB     &ja_h_lb4     &ja_h_lb3     &ja_h_lb2     &ja_h_lb1     &ja_h_lb0        X_MB    &ja_h_rb0     &ja_h_rb1     &ja_h_rb2     &ja_h_rb3     &ja_h_rb4        X_RB
        /* ├──────┤ ╰─────────────┼─────────────┴─────────────┼─────────────┼─────────────┤ ├──────┤ ├─────────────┼─────────────┼─────────────┴───────────────────────────╯ ├──────┤ */
        X_LH                                              &cjk_spc NAV 0 &sk INT_MUHENKAN X_MH    &sk INT_HENKAN &ret_morph                                                 X_RH
        /* ╰──────╯                                           ╰─────────────┴─────────────╯ ╰──────╯ ╰─────────────┴─────────────╯                                           ╰──────╯ */
      >;
    };
    jap_nicola_layer_2 { // Layer 3
      display-name = "katakana";//"にはんご"; // = nihongo (japanese)
      /* format is (default, left shift, right shift)
╭──────╮ ╭─────────────┬─────────────┬─────────────┬─────────────┬─────────────╮ ╭──────╮ ╭─────────────┬─────────────┬─────────────┬─────────────┬─────────────╮ ╭──────╮

├──────┤ ├─────────────┼─────────────┼─────────────┼─────────────┼─────────────┤ ├──────┤ ├─────────────┼─────────────┼─────────────┼─────────────┼─────────────┤ ├──────┤
(。, ,ぁ)     (か,が,え)    (り,だ,)      (こ,ご,ゃ)    (さ,ざ,れ)               (ら,ぱ,よ)    (ち,ぢ,に)    (く,ぐ,る)    (つ,づ,ま)    (, ,ぴ,ぇ)      (、)
├──────┤ ├─────────────┼─────────────┼─────────────┼─────────────┼─────────────┤ ├──────┤ ├─────────────┼─────────────┼─────────────┼─────────────┼─────────────┤ ├──────┤
(う, , を)    (し,じ,あ)    (て,で,な)    (け,げ,ゅ)    (せ,ぜ,も)               (は,ば,み)    (と,ど,お)    (き,ぎ,の)    (い,ぽ,ょ)    (ん, ,っ)
├──────┤ ├─────────────┼─────────────┼─────────────┼─────────────┼─────────────┤ ├──────┤ ├─────────────┼─────────────┼─────────────┼─────────────┼─────────────┤ ├──────┤
(., , ぅ)     (ひ,び,ー)    (す,ず,ろ)    (ふ,ぶ,や)    (へ,べ,ぃ)               (め,ぷ,ぬ)    (そ,ぞ,ゆ)    (ね,ぺ,む)    (ほ,ぼ,わ)    (・, ,ぉ)
*/
      bindings = <
        /* ╭──────╮ ╭─────────────┬─────────────┬─────────────┬─────────────┬─────────────╮ ╭──────╮ ╭─────────────┬─────────────┬─────────────┬─────────────┬─────────────╮ ╭──────╮ */
        X_LT     &ja_k_lt4     &ja_k_lt3     &ja_k_lt2     &ja_k_lt1     &ja_k_lt0        X_MT    &ja_k_rt0     &ja_k_rt1     &ja_k_rt2     &ja_k_rt3     &ja_k_rt4        X_RT 
        /* ├──────┤ ├─────────────┼─────────────┼─────────────┼─────────────┼─────────────┤ ├──────┤ ├─────────────┼─────────────┼─────────────┼─────────────┼─────────────┤ ├──────┤ */
        X_LM     &ja_k_lm4     &ja_k_lm3     &ja_k_lm2     &ja_k_lm1     &ja_k_lm0        X_MM    &ja_k_rm0     &ja_k_rm1     &ja_k_rm2     &ja_k_rm3     &ja_k_rm4        X_RM
        /* ├──────┤ ├─────────────┼─────────────┼─────────────┼─────────────┼─────────────┤ ├──────┤ ├─────────────┼─────────────┼─────────────┼─────────────┼─────────────┤ ├──────┤ */
        X_LB     &ja_k_lb4     &ja_k_lb3     &ja_k_lb2     &ja_k_lb1     &ja_k_lb0        X_MB    &ja_k_rb0     &ja_k_rb1     &ja_k_rb2     &ja_k_rb3     &ja_k_rb4        X_RB
        /* ├──────┤ ╰─────────────┼─────────────┴─────────────┼─────────────┼─────────────┤ ├──────┤ ├─────────────┼─────────────┼─────────────┴───────────────────────────╯ ├──────┤ */
        X_LH                                               ___           ___              X_MH    ___           &ret_morph                                                 X_RH
        /* ╰──────╯                                           ╰─────────────┴─────────────╯ ╰──────╯ ╰─────────────┴─────────────╯                                           ╰──────╯ */
      >;
    };
    cole_layer { // Layer 4
      display-name = "COL_DH";    // Colemak mod DH keymap
      bindings = <
        /* ╭──────╮ ╭─────────────┬─────────────┬─────────────┬─────────────┬─────────────╮ ╭──────╮ ╭─────────────┬─────────────┬─────────────┬─────────────┬─────────────╮ ╭──────╮ */
        X_LT     &kp Q         &kp W         &kp F         &kp P         &kp B            X_MT    &kp J         &kp L         &kp U         &kp Y         &kp SEMI         X_RT                                                         
        /* ├──────┤ ├─────────────┼─────────────┼─────────────┼─────────────┼─────────────┤ ├──────┤ ├─────────────┼─────────────┼─────────────┼─────────────┼─────────────┤ ├──────┤ */
        X_LM     &hgl LGUI A   &hml LALT R   &hml LCTRL S  &hml LSHFT T  &kp G            X_MM    &kp M         &hmr RSHFT N  &hmr LCTRL E  &hmr LALT I   &hgr LGUI O      X_RM
        /* ├──────┤ ├─────────────┼─────────────┼─────────────┼─────────────┼─────────────┤ ├──────┤ ├─────────────┼─────────────┼─────────────┼─────────────┼─────────────┤ ├──────┤ */
        X_LB     &kp Z         &kp X         &kp C         &kp D         &kp V            X_MB    &kp K         &kp H         &kp COMMA     &kp DOT       &kp FSLH         X_RB
        /* ├──────┤ ╰─────────────┼─────────────┴─────────────┼─────────────┼─────────────┤ ├──────┤ ├─────────────┼─────────────┼─────────────┴───────────────────────────╯ ├──────┤ */
        X_LH                                               &lt NAV SPACE &lt SYM RET      X_MH    SMART_NUM     &smrt_shft                                                 X_RH
        /* ╰──────╯                                           ╰─────────────┴─────────────╯ ╰──────╯ ╰─────────────┴─────────────╯                                           ╰──────╯ */
      >;
    };
    gaming_layer { // Layer 5
      display-name = "GME"; 
      bindings = <
        /* ╭──────╮ ╭─────────────┬─────────────┬─────────────┬─────────────┬─────────────╮ ╭──────╮ ╭─────────────┬─────────────┬─────────────┬─────────────┬─────────────╮ ╭──────╮ */
        X_LT     &kp Q         &kp W         &kp E         &kp R         &kp T            X_MT    &kp Y         &kp U         &kp UP        &kp O         &kp P            X_RT                                                         
        /* ├──────┤ ├─────────────┼─────────────┼─────────────┼─────────────┼─────────────┤ ├──────┤ ├─────────────┼─────────────┼─────────────┼─────────────┼─────────────┤ ├──────┤ */
        X_LM     &kp A         &kp S         &kp D         &kp F         &kp G            X_MM    &kp H         &kp LEFT      &kp DOWN      &kp RIGHT     &kp SEMI         X_RM
        /* ├──────┤ ├─────────────┼─────────────┼─────────────┼─────────────┼─────────────┤ ├──────┤ ├─────────────┼─────────────┼─────────────┼─────────────┼─────────────┤ ├──────┤ */
        X_LB     &kp Z         &kp X         &kp C         &kp V         &kp B            X_MB    &kp N         &kp M         &kp COMMA     &kp DOT       &kp FSLH         X_RB
        /* ├──────┤ ╰─────────────┼─────────────┴─────────────┼─────────────┼─────────────┤ ├──────┤ ├─────────────┼─────────────┼─────────────┴───────────────────────────╯ ├──────┤ */
        X_LH                                               &lt NAV SPACE &lt FUN RET      X_MH    SMART_NUM     &smrt_shft                                                 X_RH
        /* ╰──────╯                                           ╰─────────────┴─────────────╯ ╰──────╯ ╰─────────────┴─────────────╯                                           ╰──────╯ */
      >;
    };
    colemak_typing_layer { // Layer 6
      display-name = "EPISTORY";
      bindings = <
        /* ╭──────╮ ╭─────────────┬─────────────┬─────────────┬─────────────┬─────────────╮ ╭──────╮ ╭─────────────┬─────────────┬─────────────┬─────────────┬─────────────╮ ╭──────╮ */
        X_LT     &kp Q         &kp W         &kp F         &kp P         &kp B            X_MT    &kp J         &kp L         &kp U         &kp Y         &kp SEMI         X_RT                                                         
        /* ├──────┤ ├─────────────┼─────────────┼─────────────┼─────────────┼─────────────┤ ├──────┤ ├─────────────┼─────────────┼─────────────┼─────────────┼─────────────┤ ├──────┤ */
        X_LM     &kp A         &kp R         &kp S         &kp T         &kp G            X_MM    &kp M         &kp N         &kp E         &kp I         &kp O            X_RM
        /* ├──────┤ ├─────────────┼─────────────┼─────────────┼─────────────┼─────────────┤ ├──────┤ ├─────────────┼─────────────┼─────────────┼─────────────┼─────────────┤ ├──────┤ */
        X_LB     &kp Z         &kp X         &kp C         &kp D         &kp V            X_MB    &kp K         &kp H         &kp COMMA     &kp DOT       &kp FSLH         X_RB
        /* ├──────┤ ╰─────────────┼─────────────┴─────────────┼─────────────┼─────────────┤ ├──────┤ ├─────────────┼─────────────┼─────────────┴───────────────────────────╯ ├──────┤ */
        X_LH                                               &lt NAV SPACE &lt SYM RET      X_MH    SMART_NUM     &smrt_shft                                                 X_RH
        /* ╰──────╯                                           ╰─────────────┴─────────────╯ ╰──────╯ ╰─────────────┴─────────────╯                                           ╰──────╯ */
      >;
    };

    symbol_layer { // Layer 7
      display-name = "SYM";
      bindings = <
        /* ╭──────╮ ╭─────────────┬─────────────┬─────────────┬─────────────┬─────────────╮ ╭──────╮ ╭─────────────┬─────────────┬─────────────┬─────────────┬─────────────╮ ╭──────╮ */
        X_LT     &kp EXCL      &kp AT        &kp HASH      &kp DLLR      &kp PRCNT        X_MT    &kp SLASH     &kp N7        &kp N8        &kp N9        &kp GRAVE       X_RT
        /* ├──────┤ ├─────────────┼─────────────┼─────────────┼─────────────┼─────────────┤ ├──────┤ ├──────────────┼─────────────┼─────────────┼─────────────┼────────────┤ ├──────┤ */
        X_LM     &kp PLUS      &kp EQUAL     &kp UNDER     &kp MINUS     &kp CARET        X_MM    &kp N0        &kp N4        &kp N5        &kp N6        &kp DOT         X_RM
        /* ├──────┤ ├─────────────┼─────────────┼─────────────┼─────────────┼─────────────┤ ├──────┤ ├──────────────┼─────────────┼─────────────┼─────────────┼────────────┤ ├──────┤ */
        X_LB     &kp SQT       &kp PIPE      &kp STAR      &kp AMPS      &kp DQT          X_MB    &kp SEMI      &kp N1        &kp N2        &kp N3        &kp BSLH        X_RB  
        /* ├──────┤ ╰─────────────┼─────────────┴─────────────┼─────────────┼─────────────┤ ├──────┤ ├─────────────┼─────────────┼─────────────┴───────────────────────────╯ ├──────┤ */
        X_LH                                               ___           ___              X_MH    ___           ___                                                        X_RH
        /* ╰──────╯                                           ╰─────────────┴─────────────╯ ╰──────╯ ╰─────────────┴─────────────╯                                           ╰──────╯ */
      >;
    };

    num_layer { // Layer 8
      display-name = "NUM";
      bindings = <
        /* ╭──────╮ ╭─────────────┬─────────────┬─────────────┬─────────────┬─────────────╮ ╭──────╮ ╭─────────────┬─────────────┬─────────────┬─────────────┬─────────────╮ ╭──────╮ */
        X_LT     &kp SLASH     &kp N7        &kp N8        &kp N9        &kp GRAVE        X_MT    ___           ___           ___           ___           ___              X_RT
        /* ├──────┤ ├─────────────┼─────────────┼─────────────┼─────────────┼─────────────┤ ├──────┤ ├─────────────┼─────────────┼─────────────┼─────────────┼─────────────┤ ├──────┤*/
        X_LM     &kp N0        &kp N4        &kp N5        &kp N6        &kp DOT          X_MM    ___           ___           ___           ___           ___              X_RM
        /* ├──────┤ ├─────────────┼─────────────┼─────────────┼─────────────┼─────────────┤ ├──────┤ ├─────────────┼─────────────┼─────────────┼─────────────┼─────────────┤ ├──────┤*/
        X_LB     &kp SEMI      &kp N1        &kp N2        &kp N3        &kp BSLH         X_MB    ___           ___           ___           ___           ___              X_RB
        /* ├──────┤ ╰─────────────┼─────────────┴─────────────┼─────────────┼─────────────┤ ├──────┤ ├─────────────┼─────────────┼─────────────┴───────────────────────────╯ ├──────┤ */
        X_LH                                               ___           ___              X_MH    ___           ___                                                        X_RH
        /* ╰──────╯                                           ╰─────────────┴─────────────╯ ╰──────╯ ╰─────────────┴─────────────╯                                           ╰──────╯ */
      >;

    };

    nav_layer { // Layer 9
      display-name = "NAV";
      bindings = <
        /* ╭──────╮ ╭─────────────┬─────────────┬─────────────┬─────────────┬─────────────╮ ╭──────╮ ╭─────────────┬─────────────┬─────────────┬─────────────┬─────────────╮ ╭──────╮ */
        X_LT    &kp LA(F4)    ___           ___           ___           &to DEF          X_MT    &kp PG_UP     NAV_BSPC      &kp UP        NAV_DEL       &kp HOME         X_RT
        /* ├──────┤ ├─────────────┼─────────────┼─────────────┼─────────────┼─────────────┤ ├──────┤ ├─────────────┼─────────────┼─────────────┼─────────────┼─────────────┤ ├──────┤ */
        X_LM    &kp LGUI      &kp LALT      &kp LCTRL     &mt LSHFT TAB ___              X_MM    &kp PG_DN     &kp LEFT      &kp DOWN      &kp RIGHT     &kp END          X_RM
        /* ├──────┤ ├─────────────┼─────────────┼─────────────┼─────────────┼─────────────┤ ├──────┤ ├─────────────┼─────────────┼─────────────┼─────────────┼─────────────┤ ├──────┤ */
        X_LB    &kp LC(F4)    TAB_LT        TAB_RT        &kp LS(INS)      XXX           X_MB    &kp INS       ___           ___           ___           &to DEF          X_RB  
        /* ├──────┤ ╰─────────────┼─────────────┴─────────────┼─────────────┼─────────────┤ ├──────┤ ├─────────────┼─────────────┼─────────────┴───────────────────────────╯ ├──────┤ */
        X_LH                                              ___           ___              X_MH    ___           &to HIR                                                    X_RH
        /* ╰──────╯                                           ╰─────────────┴─────────────╯ ╰──────╯ ╰─────────────┴─────────────╯                                           ╰──────╯ */

      >;

    };

    fun_layer { // Layer 10
      display-name = "FUN";
      bindings = <
        /* ╭──────╮ ╭─────────────┬─────────────┬─────────────┬─────────────┬─────────────╮ ╭──────╮ ╭─────────────┬─────────────┬─────────────┬─────────────┬─────────────╮ ╭──────╮ */
        X_LT     &kp F1        &kp F2        &kp F3        &kp F4        &kp F5           X_MT    XXX           XXX           &kp C_VOL_UP  XXX           &kp PSCRN        X_RT
        /* ├──────┤ ├─────────────┼─────────────┼─────────────┼─────────────┼─────────────┤ ├──────┤ ├─────────────┼─────────────┼─────────────┼─────────────┼─────────────┤ ├──────┤ */
        X_LM     &kp LGUI      &kp LALT      &kp LCTRL     &kp LSHFT     &kp HYPR         X_MM    XXX           XXX           &kp C_VOL_DN  XXX           XXX              X_RM
        /* ├──────┤ ├─────────────┼─────────────┼─────────────┼─────────────┼─────────────┤ ├──────┤ ├─────────────┼─────────────┼─────────────┼─────────────┼─────────────┤ ├──────┤ */
        X_LB     &kp F6        &kp F7        &kp F8        &kp F9        &kp F10          X_MB    &kp CAPS      &kp C_PREV    &kp C_PP      &kp C_NEXT    &to SYS          X_RB
        /* ├──────┤ ╰─────────────┼─────────────┴─────────────┼─────────────┼─────────────┤ ├──────┤ ├─────────────┼─────────────┼─────────────┴───────────────────────────╯ ├──────┤ */
        X_LH                                               ___           ___              X_MH    &kp F11       &kp F12                                                    X_RH                            
        /* ╰──────╯                                           ╰─────────────┴─────────────╯ ╰──────╯ ╰─────────────┴─────────────╯                                           ╰──────╯ */
      >;

    };

    sys_layer { // Layer 11 
      display-name = "SYS";
      bindings = <
        /* ╭──────╮ ╭─────────────┬─────────────┬─────────────┬─────────────┬─────────────╮ ╭──────╮ ╭─────────────┬─────────────┬─────────────┬─────────────┬─────────────╮ ╭──────╮ */
        X_LT     &bt BT_CLR_ALL XXX           XXX          &out OUT_USB  &out OUT_BLE     X_MT    XXX           XXX           XXX           &to HIR       &studio_unlock   X_RT
        /* ├──────┤ ├─────────────┼─────────────┼─────────────┼─────────────┼─────────────┤ ├──────┤ ├─────────────┼─────────────┼─────────────┼─────────────┼─────────────┤ ├──────┤ */
        X_LM     &bt BT_SEL 0  &bt BT_SEL 1  &bt BT_SEL 2  &bt BT_SEL 3  &bt BT_SEL 4     X_MM    XXX           XXX           XXX           &to GME       &to COLTYPE      X_RM
        /* ├──────┤ ├─────────────┼─────────────┼─────────────┼─────────────┼─────────────┤ ├──────┤ ├─────────────┼─────────────┼─────────────┼─────────────┼─────────────┤ ├──────┤ */
        X_LB     &bt BT_CLR    &bt BT_PRV    &bt BT_NXT    XXX           &sys_reset       X_MB    &sys_reset    XXX           XXX           &to COL_DH    &to DEF          X_RB
        /* ├──────┤ ╰─────────────┼─────────────┴─────────────┼─────────────┼─────────────┤ ├──────┤ ├─────────────┼─────────────┼─────────────┴───────────────────────────╯ ├──────┤ */
        X_LH                                               ___           &bootloader      X_MH    &bootloader   XXX                                                        X_RH 
        /* ╰──────╯                                           ╰─────────────┴─────────────╯ ╰──────╯ ╰─────────────┴─────────────╯                                           ╰──────╯ */
      >;
    };
    extra_layer_1 { // Layer 12 
      status = "reserved";
      // display-name = "EXT1";
      // bindings = <

      // >;
    };
    extra_layer_2 { // Layer 13
      status = "reserved";
      // display-name = "EXT2";
      // bindings = <

      // >;
    };
  };
};

// Layer Template
/* ╭──────╮ ╭─────────────┬─────────────┬─────────────┬─────────────┬─────────────╮ ╭──────╮ ╭─────────────┬─────────────┬─────────────┬─────────────┬─────────────╮ ╭──────╮ */
// X_LT     X_MT    X_RT                                                         
/* ├──────┤ ├─────────────┼─────────────┼─────────────┼─────────────┼─────────────┤ ├──────┤ ├─────────────┼─────────────┼─────────────┼─────────────┼─────────────┤ ├──────┤ */
// X_LM     X_MM    X_RM
/* ├──────┤ ├─────────────┼─────────────┼─────────────┼─────────────┼─────────────┤ ├──────┤ ├─────────────┼─────────────┼─────────────┼─────────────┼─────────────┤ ├──────┤ */
// X_LB     X_MB    X_RB
/* ├──────┤ ╰─────────────┼─────────────┴─────────────┼─────────────┼─────────────┤ ├──────┤ ├─────────────┼─────────────┼─────────────┴───────────────────────────╯ ├──────┤ */
// X_LH     X_MH    X_RH
/* ╰──────╯                                           ╰─────────────┴─────────────╯ ╰──────╯ ╰─────────────┴─────────────╯                                           ╰──────╯ */
